/*@!Encoding:65001*/
/******************************************************************************
 * DoIP_Transport.cin - DoIP传输层（基于自定义 DoIP_Core.dll）
 *
 * 本文件提供 UDS_SendRaw() 和 UDS_Init() 的 DoIP 实现，
 * 与 CAN_Transport.cin 互斥使用。
 *
 * 工作原理:
 *   - UDS_Init() 通过 DLL 建立TCP连接并完成 Routing Activation
 *   - UDS_SendRaw() 通过 DLL 发送UDS裸字节并同步等待响应
 *   - KeepAlive (3E 80) 由 DLL 内部后台线程管理
 *
 * 不需要ISO-TP分帧：DoIP over TCP天然支持任意长度UDS payload。
 *
 * 依赖:
 *   - ./Modules/DoIP_Core.dll (自定义 DoIP 实现, 不依赖 CANoe)
 *   - PKI_Config.cin 中配置了 gDoIP_* 参数
 *   - CANoe diagSetTarget / diagGenerateKeyFromSeed (Seed&Key 仍走 CANoe)
 *
 * 切换回CAN模式时，用 CAN_Transport.cin 替换本文件即可。
 ******************************************************************************/

#pragma library("./Modules/DoIP_Core.dll")

variables
{
  /* ========== DoIP 连接状态 ========== */
  int   gDoIP_Connected = 0;         /* 0=未连接, 1=已连接, -1=连接失败 */
}

/******************************************************************************
 * 初始化 DoIP 传输通道
 *
 * 与 CAN 版保持相同的函数签名 UDS_Init(txId, rxId, ecuQualifier)，
 * 以保证上层代码零修改。txId/rxId 在 DoIP 模式下忽略。
 *
 * 实际动作: 建立TCP连接 + Routing Activation。
 ******************************************************************************/
void UDS_Init(dword txId, dword rxId, char ecuQualifier[])
{
  long ret;

  /* ECU Qualifier 仍需设置（Seed&Key DLL依赖） */
  strncpy(gUDS_EcuQualifier, ecuQualifier, elcount(gUDS_EcuQualifier)-1);
  if (0 != diagSetTarget(gUDS_EcuQualifier))
    write("DoIP_Transport: diagSetTarget失败(DLL调用可能受影响)");

  /* 配置 DoIP 连接参数 */
  DoIP_CreateConnection(gDoIP_LocalIp, gDoIP_EcuIp,
                         gDoIP_TesterAddr, gDoIP_EcuAddr);
  DoIP_SetTimeout(5000, 5000);

  /* 建立TCP连接 + Routing Activation (阻塞) */
  write("DoIP_Transport: 正在连接 %s ...", gDoIP_EcuIp);
  ret = DoIP_Connect();
  if (ret != 0)
  {
    write("DoIP_Transport: 连接失败! 错误码=%d", ret);
    gDoIP_Connected = -1;
    return;
  }

  gDoIP_Connected = 1;
  write("DoIP_Transport: 初始化完成, ECU=%s IP=%s SA=0x%04X TA=0x%04X (CAN ID 0x%03X/0x%03X 忽略)",
        gUDS_EcuQualifier, gDoIP_EcuIp, gDoIP_TesterAddr, gDoIP_EcuAddr, txId, rxId);
}

/******************************************************************************
 * 发送原始UDS请求并等待响应 (DoIP版)
 * 调用前须预先填入 gUDS_TxBuf[] 和 gUDS_TxLen
 *
 * 返回: 1=成功  0=超时  -1=错误
 *
 * 注意: DoIP模式下不支持 gIsoTp_InterruptAfterCF（无ISO-TP分帧概念），
 * 该变量设置在DoIP模式下被忽略，不会返回 2。
 ******************************************************************************/
int UDS_SendRaw()
{
  long  ret;
  int   txLen;
  dword t0, elapsedMs;

  if (gDoIP_Connected != 1)
  {
    write("DoIP_Transport: 未连接, 无法发送");
    return -1;
  }

  txLen = gUDS_TxLen;
  gUDS_RxReady = 0;
  gUDS_RxLen   = 0;

  /* 请求间隔: 确保ECU有足够时间处理上一条请求 */
  testWaitForTextEvent("__delay__", cUDS_InterReqDelay);

  /* 打印TX报文 */
  UDS_FormatHex(gUDS_TxBuf, txLen, gUDS_HexBuf, elcount(gUDS_HexBuf));
  t0 = timeNow();
  write("TX [DoIP→0x%04X] %d bytes: %s", gDoIP_EcuAddr, txLen, gUDS_HexBuf);

  /* 发送诊断报文 (DLL 内部 DoIP 封装 + TCP send) */
  ret = DoIP_Send(gDoIP_EcuAddr, gUDS_TxBuf, (dword)txLen);
  if (ret != 0)
  {
    elapsedMs = (timeNow() - t0) / 100;
    write("TX [DoIP→0x%04X] ERROR: 发送失败 ret=%d (%dms)",
          gDoIP_EcuAddr, ret, elapsedMs);
    return -1;
  }

  /* 接收响应 (DLL 内部 TCP recv + DoIP 解析, 同步阻塞) */
  ret = DoIP_Recv(gUDS_RxBuf, elcount(gUDS_RxBuf), cUDS_DefaultTimeout);
  if (ret <= 0)
  {
    elapsedMs = (timeNow() - t0) / 100;
    if (ret == 0)
      write("RX [DoIP←0x%04X] TIMEOUT: 等待响应超时 %dms", gDoIP_EcuAddr, elapsedMs);
    else
      write("RX [DoIP←0x%04X] ERROR: 接收错误 ret=%d (%dms)", gDoIP_EcuAddr, ret, elapsedMs);
    return (ret == 0) ? 0 : -1;
  }
  gUDS_RxLen   = ret;
  gUDS_RxReady = 1;

  /* 打印RX报文 */
  elapsedMs = (timeNow() - t0) / 100;
  UDS_FormatHex(gUDS_RxBuf, gUDS_RxLen, gUDS_HexBuf, elcount(gUDS_HexBuf));
  write("RX [DoIP←0x%04X] %d bytes (%dms): %s",
        gDoIP_EcuAddr, gUDS_RxLen, elapsedMs, gUDS_HexBuf);

  /* NRC 0x78 Pending: 继续等待下一条响应 */
  while (gUDS_RxLen >= 3 && gUDS_RxBuf[0] == 0x7F && gUDS_RxBuf[2] == 0x78)
  {
    write("RX [DoIP←0x%04X] NRC 0x78 Pending, 继续等待...", gDoIP_EcuAddr);

    ret = DoIP_Recv(gUDS_RxBuf, elcount(gUDS_RxBuf), cUDS_P2StarTimeout);
    if (ret <= 0)
    {
      elapsedMs = (timeNow() - t0) / 100;
      write("RX [DoIP←0x%04X] TIMEOUT: P2*超时 %dms", gDoIP_EcuAddr, elapsedMs);
      return 0;
    }
    gUDS_RxLen   = ret;
    gUDS_RxReady = 1;

    elapsedMs = (timeNow() - t0) / 100;
    UDS_FormatHex(gUDS_RxBuf, gUDS_RxLen, gUDS_HexBuf, elcount(gUDS_HexBuf));
    write("RX [DoIP←0x%04X] %d bytes (%dms): %s",
          gDoIP_EcuAddr, gUDS_RxLen, elapsedMs, gUDS_HexBuf);
  }

  return 1;
}

/******************************************************************************
 * 启动 TesterPresent 保活 (3E 80, DLL内部后台线程)
 ******************************************************************************/
void UDS_StartKeepAlive()
{
  DoIP_StartKeepAlive(2000);
  write("DoIP_Transport: KeepAlive started (3E 80 every 2000ms, DLL thread)");
}

/******************************************************************************
 * 停止 TesterPresent 保活
 ******************************************************************************/
void UDS_StopKeepAlive()
{
  DoIP_StopKeepAlive();
  write("DoIP_Transport: KeepAlive stopped");
}
