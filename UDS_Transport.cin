/*@!Encoding:65001*/
/******************************************************************************
 * UDS_Transport.cin - CAN/DoIP 双模传输层
 *
 * 合并 CAN_Transport 和 DoIP_Transport，通过 gUDS_CommMode 变量
 * 在运行时选择底层传输方式:
 *   gUDS_CommMode = 0 → CAN (ISO-TP)
 *   gUDS_CommMode = 1 → DoIP (CANoe IP_Endpoint API, Trace可见)
 *
 * 对外接口:
 *   UDS_Init(txId, rxId, ecuQualifier)  初始化传输通道
 *   UDS_SendRaw()                       发送UDS请求并等待响应
 *   UDS_StartKeepAlive()                启动TesterPresent保活
 *   UDS_StopKeepAlive()                 停止TesterPresent保活
 *   UDS_Reconnect()                     DoIP重连(ECU复位后)
 *
 * 使用方法:
 *   .can 文件中:
 *     includes {
 *       #pragma library("./Modules/SecurityKeyBridge.dll")
 *       #include "UDS_Transport.cin"
 *       #include "UDS_Services.cin"
 *     }
 *   variables 中设置 gUDS_CommMode 即可。
 *
 * 注意:
 *   - gUDS_CommMode 应在 UDS_Init() 之前设置
 *   - DoIP 模式使用 CANoe IP_Endpoint TCP API，无需外部 DLL
 *   - on message 回调总是注册，但 DoIP 模式下 gUDS_RxId=0 自动跳过
 ******************************************************************************/

variables
{
  /* ========== 通信模式 ========== */
  /* 0=CAN (ISO-TP), 1=DoIP (TCP/IP) — 在 .can 的 variables 中覆盖 */
  byte gUDS_CommMode = 0;

  /* ========== DoIP 连接状态 ========== */
  int   gDoIP_Connected = 0;         /* 0=未连接, 1=已连接, -1=连接失败 */
  dword gDoIP_Socket    = 0;         /* TCP socket handle */

  /* ========== DoIP 协议常量 ========== */
  const byte  cDoIP_Version     = 0x02;
  const byte  cDoIP_InvVersion  = 0xFD;
  const dword cDoIP_Port        = 13400;
  const int   cDoIP_HeaderLen   = 8;

  /* DoIP Payload Types */
  const word  cDoIP_RoutingActReq   = 0x0005;
  const word  cDoIP_RoutingActResp  = 0x0006;
  const word  cDoIP_DiagMessage     = 0x8001;
  const word  cDoIP_DiagPosAck      = 0x8002;
  const word  cDoIP_DiagNegAck      = 0x8003;
  const word  cDoIP_AliveCheckReq   = 0x0007;
  const word  cDoIP_AliveCheckResp  = 0x0008;

  /* ========== DoIP 接收缓冲区 ========== */
  char  gDoIP_CharRxBuf[16400];      /* IP_Endpoint API 要求 char[] */
  byte  gDoIP_RxBuf[16400];          /* DoIP 帧拼包缓冲区 */
  dword gDoIP_RxPos = 0;

  /* ========== DoIP 重连参数 ========== */
  const long  cDoIP_ReconnectMaxWait  = 30000;  /* 重连最长等待 ms */
  const long  cDoIP_ReconnectInterval = 2000;   /* 重连重试间隔 ms */

  /* ========== ISO-TP 接收状态机 ========== */
  dword gIsoTp_RxExpected;
  byte  gIsoTp_RxSN;
  int   gIsoTp_RxActive;

  /* ========== ISO-TP 发送时等待FC ========== */
  int   gIsoTp_FcReady;
  byte  gIsoTp_FcBS;
  byte  gIsoTp_FcSTmin;

  /* ========== ISO-TP 超时 ========== */
  const long cIsoTp_FcTimeout = 1000;

  /* ========== TesterPresent 保活定时器 (CAN模式) ========== */
  msTimer gUDS_KeepAliveTimer;
  int     gUDS_KeepAliveActive = 0;

  /* ========== ISO-TP 多帧互斥锁 ========== */
  int     gIsoTp_TxBusy = 0;
}

/*=============================================================================
 *
 *   DoIP (CANoe IP_Endpoint API) 传输层内部函数
 *
 *=============================================================================*/

/******************************************************************************
 * DoIP 帧构建辅助函数
 ******************************************************************************/
void DoIP_BuildHeader(byte buf[], word payloadType, dword payloadLen)
{
  buf[0] = cDoIP_Version;
  buf[1] = cDoIP_InvVersion;
  buf[2] = (byte)((payloadType >> 8) & 0xFF);
  buf[3] = (byte)(payloadType & 0xFF);
  buf[4] = (byte)((payloadLen >> 24) & 0xFF);
  buf[5] = (byte)((payloadLen >> 16) & 0xFF);
  buf[6] = (byte)((payloadLen >> 8) & 0xFF);
  buf[7] = (byte)(payloadLen & 0xFF);
}

int DoIP_ParseHeader(byte buf[], dword bufLen, word &payloadType, dword &payloadLen)
{
  if (bufLen < 8) return -1;
  if ((buf[0] ^ 0xFF) != buf[1]) return -2;
  payloadType = ((word)buf[2] << 8) | (word)buf[3];
  payloadLen  = ((dword)buf[4] << 24) | ((dword)buf[5] << 16)
              | ((dword)buf[6] << 8)  | (dword)buf[7];
  return 0;
}

int DoIP_BuildRoutingActReq(byte buf[], dword bufSize, dword testerAddr)
{
  if (bufSize < 15) return -1;
  DoIP_BuildHeader(buf, cDoIP_RoutingActReq, 7);
  buf[8]  = (byte)((testerAddr >> 8) & 0xFF);
  buf[9]  = (byte)(testerAddr & 0xFF);
  buf[10] = 0x00;  /* Activation Type: Default */
  buf[11] = 0x00;  buf[12] = 0x00;  buf[13] = 0x00;  buf[14] = 0x00;
  return 15;
}

int DoIP_BuildDiagMsg(byte buf[], dword bufSize,
                      dword srcAddr, dword tgtAddr,
                      byte udsData[], int udsLen)
{
  dword payloadLen;
  int totalLen, i;
  payloadLen = 4 + udsLen;
  totalLen   = 8 + payloadLen;
  if (bufSize < totalLen) return -1;
  DoIP_BuildHeader(buf, cDoIP_DiagMessage, payloadLen);
  buf[8]  = (byte)((srcAddr >> 8) & 0xFF);
  buf[9]  = (byte)(srcAddr & 0xFF);
  buf[10] = (byte)((tgtAddr >> 8) & 0xFF);
  buf[11] = (byte)(tgtAddr & 0xFF);
  for (i = 0; i < udsLen; i++)
    buf[12 + i] = udsData[i];
  return totalLen;
}

int DoIP_BuildAliveCheckResp(byte buf[], dword bufSize, dword testerAddr)
{
  if (bufSize < 10) return -1;
  DoIP_BuildHeader(buf, cDoIP_AliveCheckResp, 2);
  buf[8] = (byte)((testerAddr >> 8) & 0xFF);
  buf[9] = (byte)(testerAddr & 0xFF);
  return 10;
}

void DoIP_TcpSendBytes(byte data[], dword len)
{
  char sendBuf[16400];
  memcpy(sendBuf, data, len);
  TcpSend(gDoIP_Socket, sendBuf, len);
}

/******************************************************************************
 * TCP 回调: 连接结果
 ******************************************************************************/
void OnTcpConnect(dword socket, long result)
{
  if (socket != gDoIP_Socket) return;
  if (result != 0)
  {
    write("DoIP_TCP: connect failed, result=%d", result);
    gDoIP_Connected = -1;
    testSupplyTextEvent("DoIP_ConnectResult");
    return;
  }
  write("DoIP_TCP: TCP connected, arming receive and sending Routing Activation...");
  TcpReceive(socket, gDoIP_CharRxBuf, elcount(gDoIP_CharRxBuf));
  {
    byte raBuf[15];
    int  raLen;
    raLen = DoIP_BuildRoutingActReq(raBuf, elcount(raBuf), gDoIP_TesterAddr);
    if (raLen > 0)
      DoIP_TcpSendBytes(raBuf, (dword)raLen);
    else
    { write("DoIP_TCP: build RA request failed"); gDoIP_Connected = -1; testSupplyTextEvent("DoIP_ConnectResult"); }
  }
}

/******************************************************************************
 * TCP 回调: 数据接收 (IP_Endpoint API, 流式拼包)
 ******************************************************************************/
void OnTcpReceive(dword socket, long result, IP_Endpoint remoteEndpoint,
                  char buffer[], dword size)
{
  dword i;
  word  payloadType;
  dword payloadLen, frameLen;

  if (socket != gDoIP_Socket) return;
  if (result != 0)
  { write("DoIP_TCP: recv error result=%d", result); gDoIP_Connected = -1; return; }

  for (i = 0; i < size && gDoIP_RxPos < elcount(gDoIP_RxBuf); i++)
    gDoIP_RxBuf[gDoIP_RxPos++] = (byte)buffer[i];

  while (gDoIP_RxPos >= 8)
  {
    if (DoIP_ParseHeader(gDoIP_RxBuf, gDoIP_RxPos, payloadType, payloadLen) != 0)
    { write("DoIP_TCP: bad header, reset buffer"); gDoIP_RxPos = 0;
      TcpReceive(socket, gDoIP_CharRxBuf, elcount(gDoIP_CharRxBuf)); return; }
    frameLen = 8 + payloadLen;
    if (gDoIP_RxPos < frameLen)
    { TcpReceive(socket, gDoIP_CharRxBuf, elcount(gDoIP_CharRxBuf)); return; }
    DoIP_HandleFrame(payloadType, gDoIP_RxBuf, frameLen);
    if (gDoIP_RxPos > frameLen)
    { for (i = 0; i < gDoIP_RxPos - frameLen; i++) gDoIP_RxBuf[i] = gDoIP_RxBuf[frameLen + i];
      gDoIP_RxPos = gDoIP_RxPos - frameLen; }
    else
      gDoIP_RxPos = 0;
  }
  TcpReceive(socket, gDoIP_CharRxBuf, elcount(gDoIP_CharRxBuf));
}

void OnTcpClose(dword socket, long result)
{
  if (socket != gDoIP_Socket) return;
  write("DoIP_TCP: connection closed, result=%d", result);
  gDoIP_Connected = -1;
}

/******************************************************************************
 * DoIP 帧分发处理
 ******************************************************************************/
void DoIP_HandleFrame(word payloadType, byte frame[], dword frameLen)
{
  dword payloadLen, udsLen, i;
  word  srcAddr, tgtAddr;
  byte  respCode, ackCode;

  payloadLen = frameLen - 8;

  switch (payloadType)
  {
    case 0x0006:  /* Routing Activation Response */
      if (payloadLen < 5)
      { write("DoIP_TCP: RA response too short (%d)", payloadLen);
        gDoIP_Connected = -1; testSupplyTextEvent("DoIP_ConnectResult"); return; }
      srcAddr  = ((word)frame[8] << 8) | (word)frame[9];
      tgtAddr  = ((word)frame[10] << 8) | (word)frame[11];
      respCode = frame[12];
      if (respCode == 0x10)
      { write("DoIP_TCP: Routing Activation OK (tester=0x%04X entity=0x%04X)", srcAddr, tgtAddr);
        gDoIP_Connected = 1; }
      else
      { write("DoIP_TCP: Routing Activation FAILED code=0x%02X", respCode);
        gDoIP_Connected = -1; }
      testSupplyTextEvent("DoIP_ConnectResult");
      break;

    case 0x8001:  /* Diagnostic Message */
      if (payloadLen < 5) return;
      udsLen = payloadLen - 4;
      if (udsLen > elcount(gUDS_RxBuf)) udsLen = elcount(gUDS_RxBuf);
      for (i = 0; i < udsLen; i++)
        gUDS_RxBuf[i] = frame[12 + i];
      gUDS_RxLen = udsLen; gUDS_RxReady = 1;
      testSupplyTextEvent("UDS_RxDone");
      break;

    case 0x8002:  /* Diagnostic Positive ACK */
      break;

    case 0x8003:  /* Diagnostic Negative ACK */
      if (payloadLen >= 5)
      { ackCode = frame[12]; write("DoIP_TCP: Diagnostic NACK code=0x%02X", ackCode); }
      gUDS_RxReady = -1; testSupplyTextEvent("UDS_RxDone");
      break;

    case 0x0007:  /* Alive Check Request */
    { byte acBuf[10]; int acLen;
      acLen = DoIP_BuildAliveCheckResp(acBuf, elcount(acBuf), gDoIP_TesterAddr);
      if (acLen > 0) DoIP_TcpSendBytes(acBuf, (dword)acLen);
      write("DoIP_TCP: Alive Check -> responded"); break; }

    default:
      write("DoIP_TCP: unknown payload type 0x%04X len=%d", payloadType, payloadLen);
      break;
  }
}

/*=============================================================================
 *
 *   CAN (ISO-TP) 传输层内部函数
 *
 *=============================================================================*/

int IsoTp_DlcToLen(int dlc)
{
  if (dlc <= 8)  return dlc;
  if (dlc == 9)  return 12;
  if (dlc == 10) return 16;
  if (dlc == 11) return 20;
  if (dlc == 12) return 24;
  if (dlc == 13) return 32;
  if (dlc == 14) return 48;
  if (dlc == 15) return 64;
  return dlc;
}

int IsoTp_LenToFdDlc(int len)
{
  if (len <= 8)  return 8;
  if (len <= 12) return 9;
  if (len <= 16) return 10;
  if (len <= 20) return 11;
  if (len <= 24) return 12;
  if (len <= 32) return 13;
  if (len <= 48) return 14;
  if (len <= 64) return 15;
  return 15;
}

/******************************************************************************
 * ISO-TP 接收 (ECU→测试仪, 动态RxId)
 * DoIP 模式下 gUDS_RxId=0, 不会匹配任何 CAN 帧, 自动跳过
 ******************************************************************************/
on message 0x600-0x7FF
{
  byte  pci, ft, sn, fs;
  dword dlen;
  int   i, dataStart, frameLen;

  if (this.id != gUDS_RxId) return;

  frameLen = IsoTp_DlcToLen(this.dlc);
  if (frameLen < 1) return;
  pci = this.byte(0);
  ft  = (pci >> 4) & 0x0F;

  if (ft == 0)
  {
    dlen = (dword)(pci & 0x0F);
    if (dlen == 0)
    {
      if (frameLen < 2) { gUDS_RxReady = -1; testSupplyTextEvent("UDS_RxDone"); return; }
      dlen = (dword)this.byte(1);
      dataStart = 2;
    }
    else { dataStart = 1; }
    if (dlen == 0 || (int)dlen > frameLen - dataStart) { gUDS_RxReady = -1; testSupplyTextEvent("UDS_RxDone"); return; }
    for (i = 0; i < (int)dlen; i++)
      gUDS_RxBuf[i] = this.byte(dataStart + i);
    gUDS_RxLen = dlen; gUDS_RxReady = 1; gIsoTp_RxActive = 0;
    testSupplyTextEvent("UDS_RxDone");
  }
  else if (ft == 1)
  {
    dlen = ((dword)(pci & 0x0F) << 8) | (dword)this.byte(1);
    if (dlen == 0)
    {
      if (frameLen < 6) { gUDS_RxReady = -1; testSupplyTextEvent("UDS_RxDone"); return; }
      dlen = ((dword)this.byte(2) << 24) | ((dword)this.byte(3) << 16)
           | ((dword)this.byte(4) << 8)  |  (dword)this.byte(5);
      dataStart = 6;
    }
    else { dataStart = 2; }
    if (dlen == 0 || dlen > elcount(gUDS_RxBuf)) { gUDS_RxReady = -1; testSupplyTextEvent("UDS_RxDone"); return; }
    gIsoTp_RxExpected = dlen; gIsoTp_RxSN = 1; gIsoTp_RxActive = 1; gUDS_RxLen = 0;
    for (i = dataStart; i < frameLen && gUDS_RxLen < dlen; i++)
    { gUDS_RxBuf[gUDS_RxLen] = this.byte(i); gUDS_RxLen++; }
    IsoTp_SendFC();
  }
  else if (ft == 2)
  {
    if (!gIsoTp_RxActive) return;
    sn = pci & 0x0F;
    if (sn != gIsoTp_RxSN) { gUDS_RxReady = -1; gIsoTp_RxActive = 0; testSupplyTextEvent("UDS_RxDone"); return; }
    gIsoTp_RxSN = (byte)((gIsoTp_RxSN + 1) & 0x0F);
    for (i = 1; i < frameLen && gUDS_RxLen < gIsoTp_RxExpected; i++)
    { gUDS_RxBuf[gUDS_RxLen] = this.byte(i); gUDS_RxLen++; }
    if (gUDS_RxLen >= gIsoTp_RxExpected)
    { gUDS_RxLen = gIsoTp_RxExpected; gIsoTp_RxActive = 0; gUDS_RxReady = 1; testSupplyTextEvent("UDS_RxDone"); }
  }
  else if (ft == 3)
  {
    fs = pci & 0x0F;
    if (fs == 0)
    {
      gIsoTp_FcBS = this.byte(1);
      { byte rawST; rawST = this.byte(2);
        if (rawST <= 0x7F) gIsoTp_FcSTmin = rawST;
        else if (rawST >= 0xF1 && rawST <= 0xF9) gIsoTp_FcSTmin = 1;
        else gIsoTp_FcSTmin = 0x7F;
      }
      gIsoTp_FcReady = 1; testSupplyTextEvent("UDS_FcDone");
    }
    else if (fs == 1) { }
    else { gIsoTp_FcReady = -1; testSupplyTextEvent("UDS_FcDone"); }
  }
}

void IsoTp_SendFC()
{
  message * msg;
  msg.dlc = 8; msg.FDF = gUDS_UseFD; msg.BRS = 0; msg.id = gUDS_TxId;
  msg.byte(0) = 0x30; msg.byte(1) = 0x00; msg.byte(2) = 0x00; msg.byte(3) = 0x00;
  msg.byte(4) = 0x00; msg.byte(5) = 0x00; msg.byte(6) = 0x00; msg.byte(7) = 0x00;
  output(msg);
}

/******************************************************************************
 * CAN: 发送原始UDS请求并等待响应 (ISO-TP)
 ******************************************************************************/
int UDS_SendRaw_CAN()
{
  message * msg;
  int   txLen, offset, chunkLen, batchCount, i;
  byte  sn;
  dword t0, elapsedMs;
  int   fdDlc, fdLen, cfDlc, cfLen;

  gUDS_RxReady = 0; gUDS_RxLen = 0; gIsoTp_RxActive = 0;
  txLen = gUDS_TxLen;

  testWaitForTextEvent("__delay__", cUDS_InterReqDelay);

  UDS_FormatHex(gUDS_TxBuf, txLen, gUDS_HexBuf, elcount(gUDS_HexBuf));
  t0 = timeNow();
  write("TX [0x%03X] %d bytes: %s", gUDS_TxId, txLen, gUDS_HexBuf);

  msg.FDF = gUDS_UseFD; msg.BRS = 0; msg.id = gUDS_TxId;

  if (txLen <= 7)
  {
    msg.dlc = 8; msg.byte(0) = (byte)txLen;
    for (i = 0; i < txLen; i++) msg.byte(i + 1) = gUDS_TxBuf[i];
    for (i = txLen + 1; i < 8; i++) msg.byte(i) = 0x00;
    output(msg);
  }
  else if (txLen <= 62 && gUDS_UseFD)
  {
    fdDlc = IsoTp_LenToFdDlc(txLen + 2); fdLen = IsoTp_DlcToLen(fdDlc);
    msg.dlc = fdDlc; msg.byte(0) = 0x00; msg.byte(1) = (byte)txLen;
    for (i = 0; i < txLen; i++) msg.byte(i + 2) = gUDS_TxBuf[i];
    for (i = txLen + 2; i < fdLen; i++) msg.byte(i) = 0xCC;
    output(msg);
  }
  else
  {
    gIsoTp_FcReady = 0; gIsoTp_TxBusy = 1;
    if (gUDS_UseFD)
    {
      msg.dlc = 15;
      msg.byte(0) = (byte)(0x10 | ((txLen >> 8) & 0x0F));
      msg.byte(1) = (byte)(txLen & 0xFF);
      for (i = 0; i < 62 && i < txLen; i++) msg.byte(i + 2) = gUDS_TxBuf[i];
      for (i = txLen + 2; i < 64; i++) msg.byte(i) = 0xCC;
    }
    else
    {
      msg.dlc = 8;
      msg.byte(0) = (byte)(0x10 | ((txLen >> 8) & 0x0F));
      msg.byte(1) = (byte)(txLen & 0xFF);
      for (i = 0; i < 6; i++) msg.byte(i + 2) = gUDS_TxBuf[i];
    }
    output(msg);

    if (testWaitForTextEvent("UDS_FcDone", cIsoTp_FcTimeout) == 0 || gIsoTp_FcReady <= 0)
    { elapsedMs = (timeNow() - t0) / 100; write("RX [0x%03X] ERROR: FC超时 (%dms)", gUDS_RxId, elapsedMs); gIsoTp_TxBusy = 0; return -1; }

    offset = gUDS_UseFD ? 62 : 6; if (offset > txLen) offset = txLen;
    sn = 1; batchCount = 0;
    while (offset < txLen)
    {
      chunkLen = txLen - offset;
      if (gUDS_UseFD)
      {
        if (chunkLen > 63) chunkLen = 63;
        cfDlc = IsoTp_LenToFdDlc(chunkLen + 1); cfLen = IsoTp_DlcToLen(cfDlc);
        msg.dlc = cfDlc; msg.byte(0) = (byte)(0x20 | (sn & 0x0F));
        for (i = 0; i < chunkLen; i++) msg.byte(i + 1) = gUDS_TxBuf[offset + i];
        for (i = chunkLen + 1; i < cfLen; i++) msg.byte(i) = 0xCC;
      }
      else
      {
        if (chunkLen > 7) chunkLen = 7;
        msg.dlc = 8; msg.byte(0) = (byte)(0x20 | (sn & 0x0F));
        for (i = 0; i < chunkLen; i++) msg.byte(i + 1) = gUDS_TxBuf[offset + i];
        for (i = chunkLen + 1; i < 8; i++) msg.byte(i) = 0x00;
      }
      output(msg);
      sn = (byte)((sn + 1) & 0x0F); offset += chunkLen; batchCount++;

      if (gIsoTp_InterruptAfterCF > 0 && batchCount >= gIsoTp_InterruptAfterCF)
      { elapsedMs = (timeNow() - t0) / 100;
        write("ISOTP中断: CF #%d 后中断 (%dms)", batchCount, elapsedMs);
        gIsoTp_InterruptAfterCF = 0; gIsoTp_TxBusy = 0; return 2; }

      if (gIsoTp_FcBS > 0 && (batchCount % (int)gIsoTp_FcBS) == 0 && offset < txLen)
      { gIsoTp_FcReady = 0;
        if (testWaitForTextEvent("UDS_FcDone", cIsoTp_FcTimeout) == 0 || gIsoTp_FcReady <= 0)
        { elapsedMs = (timeNow() - t0) / 100; write("RX [0x%03X] ERROR: CF阶段FC超时 (%dms)", gUDS_RxId, elapsedMs); gIsoTp_TxBusy = 0; return -1; }
        batchCount = 0; }

      if (gIsoTp_FcSTmin > 0 && offset < txLen)
        testWaitForTextEvent("__stmin__", (long)gIsoTp_FcSTmin);
    }
  }

  gIsoTp_TxBusy = 0;

  if (testWaitForTextEvent("UDS_RxDone", cUDS_DefaultTimeout) == 0)
  { elapsedMs = (timeNow() - t0) / 100; write("RX [0x%03X] TIMEOUT (%dms)", gUDS_RxId, elapsedMs); return 0; }
  if (gUDS_RxReady == -1)
  { elapsedMs = (timeNow() - t0) / 100; write("RX [0x%03X] ERROR (%dms)", gUDS_RxId, elapsedMs); return -1; }

  elapsedMs = (timeNow() - t0) / 100;
  UDS_FormatHex(gUDS_RxBuf, gUDS_RxLen, gUDS_HexBuf, elcount(gUDS_HexBuf));
  write("RX [0x%03X] %d bytes (%dms): %s", gUDS_RxId, gUDS_RxLen, elapsedMs, gUDS_HexBuf);

  while (gUDS_RxLen >= 3 && gUDS_RxBuf[0] == 0x7F && gUDS_RxBuf[2] == 0x78)
  {
    write("RX [0x%03X] NRC 0x78 Pending, 继续等待...", gUDS_RxId);
    gUDS_RxReady = 0; gUDS_RxLen = 0;
    if (testWaitForTextEvent("UDS_RxDone", cUDS_P2StarTimeout) == 0)
    { elapsedMs = (timeNow() - t0) / 100; write("RX [0x%03X] P2*超时 (%dms)", gUDS_RxId, elapsedMs); return 0; }
    if (gUDS_RxReady != 1) return 0;
    elapsedMs = (timeNow() - t0) / 100;
    UDS_FormatHex(gUDS_RxBuf, gUDS_RxLen, gUDS_HexBuf, elcount(gUDS_HexBuf));
    write("RX [0x%03X] %d bytes (%dms): %s", gUDS_RxId, gUDS_RxLen, elapsedMs, gUDS_HexBuf);
  }
  return 1;
}

/******************************************************************************
 * DoIP: 发送原始UDS请求并等待响应 (CANoe IP_Endpoint API)
 ******************************************************************************/
int UDS_SendRaw_DoIP()
{
  int   txLen;
  dword t0, elapsedMs;
  byte  doipBuf[16400];
  int   doipLen;

  if (gDoIP_Connected != 1) { write("DoIP_TCP: not connected"); return -1; }

  gUDS_RxReady = 0; gUDS_RxLen = 0;
  txLen = gUDS_TxLen;

  testWaitForTextEvent("__delay__", cUDS_InterReqDelay);

  UDS_FormatHex(gUDS_TxBuf, txLen, gUDS_HexBuf, elcount(gUDS_HexBuf));
  t0 = timeNow();
  write("TX [DoIP->0x%04X] %d bytes: %s", gDoIP_EcuAddr, txLen, gUDS_HexBuf);

  doipLen = DoIP_BuildDiagMsg(doipBuf, elcount(doipBuf),
                              gDoIP_TesterAddr, gDoIP_EcuAddr,
                              gUDS_TxBuf, txLen);
  if (doipLen <= 0) { write("DoIP_TCP: build diag msg failed"); return -1; }
  DoIP_TcpSendBytes(doipBuf, (dword)doipLen);

  if (testWaitForTextEvent("UDS_RxDone", cUDS_DefaultTimeout) == 0)
  { elapsedMs = (timeNow() - t0) / 100; write("RX [DoIP<-0x%04X] TIMEOUT %dms", gDoIP_EcuAddr, elapsedMs); return 0; }
  if (gUDS_RxReady != 1)
  { elapsedMs = (timeNow() - t0) / 100; write("RX [DoIP<-0x%04X] ERROR (%dms)", gDoIP_EcuAddr, elapsedMs); return -1; }

  elapsedMs = (timeNow() - t0) / 100;
  UDS_FormatHex(gUDS_RxBuf, gUDS_RxLen, gUDS_HexBuf, elcount(gUDS_HexBuf));
  write("RX [DoIP<-0x%04X] %d bytes (%dms): %s", gDoIP_EcuAddr, gUDS_RxLen, elapsedMs, gUDS_HexBuf);

  while (gUDS_RxLen >= 3 && gUDS_RxBuf[0] == 0x7F && gUDS_RxBuf[2] == 0x78)
  {
    write("RX [DoIP<-0x%04X] NRC 0x78 Pending, waiting...", gDoIP_EcuAddr);
    gUDS_RxReady = 0; gUDS_RxLen = 0;
    if (testWaitForTextEvent("UDS_RxDone", cUDS_P2StarTimeout) == 0)
    { elapsedMs = (timeNow() - t0) / 100; write("RX [DoIP<-0x%04X] P2* TIMEOUT %dms", gDoIP_EcuAddr, elapsedMs); return 0; }
    if (gUDS_RxReady != 1) return 0;
    elapsedMs = (timeNow() - t0) / 100;
    UDS_FormatHex(gUDS_RxBuf, gUDS_RxLen, gUDS_HexBuf, elcount(gUDS_HexBuf));
    write("RX [DoIP<-0x%04X] %d bytes (%dms): %s", gDoIP_EcuAddr, gUDS_RxLen, elapsedMs, gUDS_HexBuf);
  }
  return 1;
}

/*=============================================================================
 *
 *   统一对外接口 — 根据 gUDS_CommMode 分发
 *
 *=============================================================================*/

void UDS_Init(dword txId, dword rxId, char ecuQualifier[])
{
  strncpy(gUDS_EcuQualifier, ecuQualifier, elcount(gUDS_EcuQualifier)-1);
  if (0 != diagSetTarget(gUDS_EcuQualifier))
    write("UDS_Transport: diagSetTarget失败");
  else
    diagStopTesterPresent();  /* 禁止CANoe诊断层自动发送3E 00 */

  if (gUDS_CommMode == 1)
  {
    IP_Endpoint localEp;
    IP_Endpoint remoteEp;
    long  result;
    char  errorText[200];

    /* DoIP 模式: 清零 CAN ID, 防止 on message 回调误触发 */
    gUDS_TxId = 0;
    gUDS_RxId = 0;

    localEp.ParseEndpointFromString(gDoIP_LocalIp);
    localEp.PortNumber = 0;
    gDoIP_Socket = TcpOpen(localEp);
    write("DoIP_TCP: TcpOpen(%s:0) -> socket=0x%08X", gDoIP_LocalIp, gDoIP_Socket);

    if (IpGetLastSocketError(gDoIP_Socket) != 0)
    {
      IpGetLastSocketErrorAsString(gDoIP_Socket, errorText, elcount(errorText));
      write("DoIP_TCP: TcpOpen FAILED: %s", errorText);
      gDoIP_Connected = -1;
      gDoIP_Socket = 0;
      return;
    }

    gDoIP_Connected = 0;
    gDoIP_RxPos     = 0;

    remoteEp.ParseEndpointFromString(gDoIP_EcuIp);
    remoteEp.PortNumber = cDoIP_Port;
    write("DoIP_TCP: connecting to %s:%d ...", gDoIP_EcuIp, cDoIP_Port);
    result = TcpConnect(gDoIP_Socket, remoteEp);

    if (result != 0 && IpGetLastSocketError(gDoIP_Socket) != 10035)
    {
      IpGetLastSocketErrorAsString(gDoIP_Socket, errorText, elcount(errorText));
      write("DoIP_TCP: TcpConnect FAILED: %s", errorText);
      TcpClose(gDoIP_Socket);
      gDoIP_Socket = 0;
      gDoIP_Connected = -1;
      return;
    }

    if (testWaitForTextEvent("DoIP_ConnectResult", 10000) == 0 || gDoIP_Connected != 1)
    {
      write("DoIP_TCP: connect/routing activation failed!");
      TcpClose(gDoIP_Socket);
      gDoIP_Socket = 0;
      gDoIP_Connected = -1;
      return;
    }

    write("DoIP_TCP: init done, ECU=%s IP=%s SA=0x%04X TA=0x%04X",
          gUDS_EcuQualifier, gDoIP_EcuIp, gDoIP_TesterAddr, gDoIP_EcuAddr);
  }
  else
  {
    gUDS_TxId = txId; gUDS_RxId = rxId;
    write("UDS_Transport [CAN]: 初始化完成 ECU=%s TxID=0x%03X RxID=0x%03X",
          gUDS_EcuQualifier, gUDS_TxId, gUDS_RxId);
  }
}

int UDS_SendRaw()
{
  if (gUDS_CommMode == 1) return UDS_SendRaw_DoIP();
  else return UDS_SendRaw_CAN();
}

void UDS_StartKeepAlive()
{
  if (gUDS_CommMode == 1)
  { gUDS_KeepAliveActive = 1; setTimer(gUDS_KeepAliveTimer, 2000);
    write("UDS_Transport [DoIP]: KeepAlive started (3E 80 every 2000ms)"); }
  else
  { gUDS_KeepAliveActive = 1; setTimer(gUDS_KeepAliveTimer, 2000);
    write("UDS_Transport [CAN]: KeepAlive started"); }
}

void UDS_StopKeepAlive()
{
  gUDS_KeepAliveActive = 0;
  cancelTimer(gUDS_KeepAliveTimer);
  if (gUDS_CommMode == 1)
    write("UDS_Transport [DoIP]: KeepAlive stopped");
  else
    write("UDS_Transport [CAN]: KeepAlive stopped");
}

/******************************************************************************
 * 统一清理接口 — 停止保活、断开 DoIP 连接、清零状态
 * 在测试结束或切换 CommMode 前调用
 ******************************************************************************/
void UDS_Deinit()
{
  UDS_StopKeepAlive();
  if (gUDS_CommMode == 1 && gDoIP_Socket != 0)
  {
    TcpClose(gDoIP_Socket);
    gDoIP_Socket = 0;
    gDoIP_Connected = 0;
    gDoIP_RxPos = 0;
    write("UDS_Transport [DoIP]: disconnected");
  }
  gUDS_TxId = 0;
  gUDS_RxId = 0;
  gUDS_EcuQualifier[0] = 0;
}

on timer gUDS_KeepAliveTimer
{
  if (!gUDS_KeepAliveActive) return;

  if (gUDS_CommMode == 1)
  {
    /* DoIP: 功能寻址 TA=0xE400 发送 3E 80 (与CAN 0x7DF同理)
     * 避免在 TransferData 等多帧传输期间, 3E 80 插入同一 SA/TA 物理通道
     * 导致 ECU 中断正在处理的请求 */
    byte kaBuf[2];
    byte doipKa[20];
    int  doipLen;
    if (gDoIP_Connected != 1) return;
    kaBuf[0] = 0x3E;
    kaBuf[1] = 0x80;
    doipLen = DoIP_BuildDiagMsg(doipKa, elcount(doipKa),
                                gDoIP_TesterAddr, 0xE400, kaBuf, 2);
    if (doipLen > 0)
      DoIP_TcpSendBytes(doipKa, (dword)doipLen);
  }
  else
  {
    /* CAN: 功能寻址 0x7DF 发送 3E 80 */
    message * kaMsg;
    if (gUDS_TxId == 0) return;
    if (gIsoTp_TxBusy) return;
    kaMsg.id      = 0x7DF;
    kaMsg.FDF     = gUDS_UseFD;
    kaMsg.BRS     = 0;
    kaMsg.dlc     = 8;
    kaMsg.byte(0) = 0x02;
    kaMsg.byte(1) = 0x3E;
    kaMsg.byte(2) = 0x80;
    kaMsg.byte(3) = 0x00;
    kaMsg.byte(4) = 0x00;
    kaMsg.byte(5) = 0x00;
    kaMsg.byte(6) = 0x00;
    kaMsg.byte(7) = 0x00;
    output(kaMsg);
  }
  setTimer(gUDS_KeepAliveTimer, 2000);
}

/******************************************************************************
 * DoIP 重连 (ECU复位后重新建立 TCP + Routing Activation)
 * 返回: 1=成功  0=失败(超时)
 ******************************************************************************/
int UDS_Reconnect()
{
  dword t0, elapsed;
  int   attempt;
  int   wasKeepAlive;
  long  maxWaitMs, retryIntervalMs;

  if (gUDS_CommMode != 1) { write("UDS_Reconnect: CAN模式无需重连"); return 1; }

  wasKeepAlive    = gUDS_KeepAliveActive;

  maxWaitMs       = cDoIP_ReconnectMaxWait;
  retryIntervalMs = cDoIP_ReconnectInterval;

  write("DoIP_TCP: 重连 %s (最长等待 %dms) ...", gDoIP_EcuIp, maxWaitMs);

  UDS_StopKeepAlive();
  if (gDoIP_Socket != 0)
  { TcpClose(gDoIP_Socket); gDoIP_Socket = 0; }
  gDoIP_Connected = 0;
  gDoIP_RxPos     = 0;

  t0 = timeNow();
  attempt = 0;

  while (1)
  {
    IP_Endpoint localEp;
    IP_Endpoint remoteEp;
    long result;
    char errorText[200];

    attempt++;

    localEp.ParseEndpointFromString(gDoIP_LocalIp);
    localEp.PortNumber = 0;
    gDoIP_Socket = TcpOpen(localEp);

    if (IpGetLastSocketError(gDoIP_Socket) != 0)
    {
      IpGetLastSocketErrorAsString(gDoIP_Socket, errorText, elcount(errorText));
      write("DoIP_TCP: 重连 TcpOpen 失败: %s", errorText);
      gDoIP_Socket = 0;
    }
    else
    {
      remoteEp.ParseEndpointFromString(gDoIP_EcuIp);
      remoteEp.PortNumber = cDoIP_Port;
      result = TcpConnect(gDoIP_Socket, remoteEp);

      if (result == 0 || IpGetLastSocketError(gDoIP_Socket) == 10035)
      {
        if (testWaitForTextEvent("DoIP_ConnectResult", 10000) != 0 && gDoIP_Connected == 1)
        {
          elapsed = (timeNow() - t0) / 100;
          write("DoIP_TCP: 重连成功 (第%d次尝试, %dms)", attempt, elapsed);
          if (wasKeepAlive)
            UDS_StartKeepAlive();
          return 1;
        }
      }

      TcpClose(gDoIP_Socket);
      gDoIP_Socket = 0;
      gDoIP_Connected = 0;
      gDoIP_RxPos     = 0;
    }

    elapsed = (timeNow() - t0) / 100;
    if (elapsed >= (dword)maxWaitMs)
    {
      write("DoIP_TCP: 重连超时! %d次尝试均失败", attempt);
      gDoIP_Connected = -1;
      return 0;
    }

    write("DoIP_TCP: 第%d次重连失败 (%dms), %dms后重试...",
          attempt, elapsed, retryIntervalMs);
    testWaitForTextEvent("__delay__", retryIntervalMs);
  }
}
