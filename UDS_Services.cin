/*@!Encoding:65001*/
/******************************************************************************
 * UDS_Services.cin - UDS服务层（传输无关，CAN/DoIP共用）
 *
 * 本文件从 UDS_Transport.cin 拆分而来，包含所有传输无关的内容：
 *   - 收发缓冲区与状态变量
 *   - UDS服务函数（10/11/14/22/27/28/2E/31/34/36/37/85）
 *   - NRC处理、CRC32、日志格式化
 *   - 测试步骤ID管理
 *
 * 传输层由 CAN_Transport.cin 或 DoIP_Transport.cin 提供：
 *   - UDS_Init()    初始化传输通道
 *   - UDS_SendRaw() 发送UDS请求并等待响应
 *
 * 注意：本文件必须在传输层之后 #include，因为服务函数调用 UDS_SendRaw()。
 ******************************************************************************/

variables
{
  /* ========== 收发缓冲区 ========== */
  byte  gUDS_RxBuf[4096];
  dword gUDS_RxLen;
  int   gUDS_RxReady;          /* 0=等待  1=成功  -1=错误 */

  byte  gUDS_TxBuf[4096];
  int   gUDS_TxLen;

  /* ========== 超时 ========== */
  const int  cUDS_DefaultTimeout = 5000;
  const int  cUDS_P2StarTimeout  = 5000;

  /* ========== 请求间隔 ========== */
  const int  cUDS_InterReqDelay  = 100;   /* ms, 避免ECU来不及切换状态 */

  /* ========== CRC32 ========== */
  const dword cCRC32_POLY = 0xEDB88320;
  const dword cCRC32_INIT = 0xFFFFFFFF;

  /* ========== ECU配置 ========== */
  char  gUDS_EcuQualifier[64]  = "";        /* UDS_Init()设置 */
  dword gUDS_SecurityLevel     = 1;

  /* ========== 测试步骤 ========== */
  char  gStepId[32];
  word  gStepTcIdx;
  word  gStepTsIdx;

  /* ========== 计时 ========== */
  dword gUDS_TxTimestamp;           /* 发送时刻(timeNow单位) */

  /* ========== ISOTP 中断钩子 (灌装中断测试用) ========== */
  /* 声明在共用层以保证TC04/TC05在DoIP模式下也能编译 */
  /* 仅CAN传输层实际使用此变量，DoIP模式下设置无效 */
  int   gIsoTp_InterruptAfterCF = 0;

  /* ========== 报告用日志缓冲区 ========== */
  char  gUDS_HexBuf[2048];         /* TX/RX报文hex格式化(全局,避免栈溢出) */
  char  gUDS_RxSummary[256];       /* DUT响应摘要, 各服务函数自动填充 */
}

/******************************************************************************
 * 测试步骤ID管理
 ******************************************************************************/
void UDS_SetStepId(word tc, word ts)
{
  gStepTcIdx = tc;
  gStepTsIdx = ts;
  snprintf(gStepId, elcount(gStepId), "TC%02d_TS%02d", gStepTcIdx, gStepTsIdx);
}

void UDS_IncStep()
{
  gStepTsIdx++;
  snprintf(gStepId, elcount(gStepId), "TC%02d_TS%02d", gStepTcIdx, gStepTsIdx);
}

/******************************************************************************
 * 检查正响应 (SID+0x40)
 ******************************************************************************/
int UDS_IsPositiveResponse(byte expectedSID)
{
  if (gUDS_RxLen < 1) return 0;
  return (gUDS_RxBuf[0] == (byte)(expectedSID + 0x40)) ? 1 : 0;
}

/******************************************************************************
 * 获取负响应码 NRC，非负响应时返回 -1
 ******************************************************************************/
int UDS_GetNRC()
{
  if (gUDS_RxLen >= 3 && gUDS_RxBuf[0] == 0x7F)
    return (int)gUDS_RxBuf[2];
  return -1;
}

/******************************************************************************
 * 10 03 进入扩展会话
 ******************************************************************************/
int UDS_DiagSessionControl_Extended()
{
  gUDS_TxBuf[0] = 0x10; gUDS_TxBuf[1] = 0x03; gUDS_TxLen = 2;
  if (UDS_SendRaw() <= 0) { UDS_FormatRxSummary(3); return 0; }
  UDS_FormatRxSummary(2);   /* 50 03 */
  if (UDS_IsPositiveResponse(0x10))
  {
    UDS_StartKeepAlive();
    return 1;
  }
  return 0;
}

/******************************************************************************
 * 10 02 进入编程会话
 ******************************************************************************/
int UDS_DiagSessionControl_Programming()
{
  gUDS_TxBuf[0] = 0x10; gUDS_TxBuf[1] = 0x02; gUDS_TxLen = 2;
  if (UDS_SendRaw() <= 0) { UDS_FormatRxSummary(3); return 0; }
  UDS_FormatRxSummary(2);   /* 50 02 */
  if (UDS_IsPositiveResponse(0x10))
  {
    UDS_StartKeepAlive();
    return 1;
  }
  return 0;
}

/******************************************************************************
 * 10 01 回到默认会话
 ******************************************************************************/
int UDS_DiagSessionControl_Default()
{
  UDS_StopKeepAlive();
  gUDS_TxBuf[0] = 0x10; gUDS_TxBuf[1] = 0x01; gUDS_TxLen = 2;
  if (UDS_SendRaw() <= 0) { UDS_FormatRxSummary(3); return 0; }
  UDS_FormatRxSummary(2);   /* 50 01 */
  return UDS_IsPositiveResponse(0x10);
}

/******************************************************************************
 * 11 01 ECU硬复位
 ******************************************************************************/
int UDS_ECUReset_Hard()
{
  gUDS_TxBuf[0] = 0x11; gUDS_TxBuf[1] = 0x01; gUDS_TxLen = 2;
  if (UDS_SendRaw() <= 0) { UDS_FormatRxSummary(2); return 0; }
  UDS_FormatRxSummary(2);
  return UDS_IsPositiveResponse(0x11);
}

/******************************************************************************
 * 27 01 请求Seed
 ******************************************************************************/
int UDS_SecurityAccess_RequestSeed(byte seedOut[], int seedBufSize, int &seedActualLen)
{
  int i;
  int actualLen;
  int retry;
  for (retry = 0; retry < 2; retry++)
  {
    gUDS_TxBuf[0] = 0x27; gUDS_TxBuf[1] = 0x01; gUDS_TxLen = 2;
    if (UDS_SendRaw() <= 0) { UDS_FormatRxSummary(3); return 0; }

    /* NRC 0x37: penalty timer still active, wait and retry once */
    if (UDS_GetNRC() == 0x37 && retry == 0)
    {
      int waitRemain;
      write("UDS_Services: NRC 0x37 (requiredTimeDelayNotExpired), waiting %d ms...", cSA_PenaltyDelay);
      /* Send 3E 80 (TesterPresent, suppressPosRsp) every 1s to keep session alive */
      waitRemain = (int)cSA_PenaltyDelay;
      while (waitRemain > 0)
      {
        message * tpMsg;
        tpMsg.id  = gUDS_TxId;
        tpMsg.FDF = gUDS_UseFD;
        tpMsg.BRS = 0;
        tpMsg.dlc = 8;
        tpMsg.byte(0) = 0x02;
        tpMsg.byte(1) = 0x3E;
        tpMsg.byte(2) = 0x80;
        tpMsg.byte(3) = 0x00;
        tpMsg.byte(4) = 0x00;
        tpMsg.byte(5) = 0x00;
        tpMsg.byte(6) = 0x00;
        tpMsg.byte(7) = 0x00;
        output(tpMsg);
        if (waitRemain > 1000)
          testWaitForTimeout(1000);
        else
          testWaitForTimeout(waitRemain);
        waitRemain -= 1000;
      }
      continue;
    }

    if (!UDS_IsPositiveResponse(0x27)) { UDS_FormatRxSummary(3); return 0; }
    actualLen = (int)gUDS_RxLen - 2;
    if (actualLen <= 0) { UDS_FormatRxSummary(2); return 0; }
    if (actualLen > seedBufSize)
    {
      write("UDS_Services: Seed长度(%d)超出缓冲区(%d)", actualLen, seedBufSize);
      UDS_FormatRxSummary(2);
      return 0;
    }
    UDS_FormatRxSummary(2);   /* 67 01 */
    for (i = 0; i < actualLen; i++)
      seedOut[i] = gUDS_RxBuf[2 + i];
    seedActualLen = actualLen;
    write("UDS_Services: Seed长度=%d字节", actualLen);
    return 1;
  }
  /* Should not reach here, but just in case */
  UDS_FormatRxSummary(3);
  return 0;
}

/******************************************************************************
 * 27 02 发送Key
 ******************************************************************************/
int UDS_SecurityAccess_SendKey(byte keyData[], int keyLen)
{
  int i;
  gUDS_TxBuf[0] = 0x27; gUDS_TxBuf[1] = 0x02;
  for (i = 0; i < keyLen; i++)
    gUDS_TxBuf[2 + i] = keyData[i];
  gUDS_TxLen = 2 + keyLen;
  if (UDS_SendRaw() <= 0) { UDS_FormatRxSummary(3); return 0; }
  UDS_FormatRxSummary(2);   /* 67 02 */
  return UDS_IsPositiveResponse(0x27);
}

/******************************************************************************
 * 通过注册的 Seed&Key DLL 计算Key
 ******************************************************************************/
int UDS_GenerateKeyFromSeed(byte seedData[], dword seedLen,
                             byte keyOut[], dword keyBufSize, dword &keyOutLen)
{
  long  ret;
  dword actualSize;

  actualSize = 0;
  ret = diagGenerateKeyFromSeed(
            gUDS_EcuQualifier,
            seedData, seedLen,
            gUDS_SecurityLevel,
            "", "",
            keyOut, keyBufSize, actualSize);

  if (ret != 0)
  {
    write("UDS_Services: diagGenerateKeyFromSeed失败 ret=%d", ret);
    return 0;
  }
  keyOutLen = actualSize;
  write("UDS_Services: Key计算成功 keyLen=%d", keyOutLen);
  return 1;
}

/******************************************************************************
 * 完整安全访问: 27 01 请求Seed + DLL计算Key + 27 02 发送Key
 ******************************************************************************/
int UDS_SecurityAccess_Unlock()
{
  byte  seedArray[32];
  byte  keyArray[32];
  dword keyLen;
  int   seedLen;

  seedLen = 0;
  if (!UDS_SecurityAccess_RequestSeed(seedArray, elcount(seedArray), seedLen))
  {
    write("UDS_Services: Seed请求失败");
    return 0;
  }
  {
    char tmpHex[128];
    UDS_FormatHex(seedArray, seedLen, tmpHex, elcount(tmpHex));
    write("UDS_Services: Seed=%s (%d字节)", tmpHex, seedLen);
  }

  keyLen = 0;
  if (!UDS_GenerateKeyFromSeed(seedArray, (dword)seedLen, keyArray, elcount(keyArray), keyLen))
  {
    write("UDS_Services: Key计算失败");
    return 0;
  }
  if (!UDS_SecurityAccess_SendKey(keyArray, (int)keyLen))
  {
    write("UDS_Services: Key验证失败 NRC=0x%02X", UDS_GetNRC());
    return 0;
  }
  write("UDS_Services: 安全访问解锁成功");
  return 1;
}

/******************************************************************************
 * 28 xx xx 通信控制
 *   subFunc: 0x00=enableRxAndTx, 0x03=disableRxAndTx
 *   commType: 0x01=normalMessage, 0x02=nmMessage, 0x03=both
 ******************************************************************************/
int UDS_CommunicationControl(byte subFunc, byte commType)
{
  gUDS_TxBuf[0] = 0x28; gUDS_TxBuf[1] = subFunc; gUDS_TxBuf[2] = commType;
  gUDS_TxLen = 3;
  if (UDS_SendRaw() <= 0) { UDS_FormatRxSummary(3); return 0; }
  UDS_FormatRxSummary(2);
  return UDS_IsPositiveResponse(0x28);
}

/******************************************************************************
 * 85 xx 控制DTC设置
 *   subFunc: 0x01=on(使能), 0x02=off(关闭)
 ******************************************************************************/
int UDS_ControlDTCSetting(byte subFunc)
{
  gUDS_TxBuf[0] = 0x85; gUDS_TxBuf[1] = subFunc;
  gUDS_TxLen = 2;
  if (UDS_SendRaw() <= 0) { UDS_FormatRxSummary(2); return 0; }
  UDS_FormatRxSummary(2);
  return UDS_IsPositiveResponse(0x85);
}

/******************************************************************************
 * 14 FF FF FF 清除DTC
 ******************************************************************************/
int UDS_ClearDTC_All()
{
  gUDS_TxBuf[0] = 0x14; gUDS_TxBuf[1] = 0xFF;
  gUDS_TxBuf[2] = 0xFF; gUDS_TxBuf[3] = 0xFF;
  gUDS_TxLen = 4;
  if (UDS_SendRaw() <= 0) { UDS_FormatRxSummary(3); return 0; }
  UDS_FormatRxSummary(1);   /* 54 */
  return UDS_IsPositiveResponse(0x14);
}

/******************************************************************************
 * 22 xx xx 读取DID
 ******************************************************************************/
int UDS_ReadDID(word did, byte dataOut[], long &dataOutLen)
{
  long i;
  gUDS_TxBuf[0] = 0x22;
  gUDS_TxBuf[1] = (byte)((did >> 8) & 0xFF);
  gUDS_TxBuf[2] = (byte)(did & 0xFF);
  gUDS_TxLen = 3;
  if (UDS_SendRaw() <= 0) { UDS_FormatRxSummary(3); return 0; }
  if (!UDS_IsPositiveResponse(0x22)) { UDS_FormatRxSummary(3); return 0; }
  if (gUDS_RxLen < 3) { UDS_FormatRxSummary((int)gUDS_RxLen); return 0; }
  UDS_FormatRxSummary((int)gUDS_RxLen);
  dataOutLen = gUDS_RxLen - 3;
  for (i = 0; i < dataOutLen; i++)
    dataOut[i] = gUDS_RxBuf[3 + i];
  return 1;
}

/******************************************************************************
 * 2E xx xx 写入DID
 ******************************************************************************/
int UDS_WriteDID(word did, byte dataIn[], int dataInLen)
{
  int i;
  gUDS_TxBuf[0] = 0x2E;
  gUDS_TxBuf[1] = (byte)((did >> 8) & 0xFF);
  gUDS_TxBuf[2] = (byte)(did & 0xFF);
  for (i = 0; i < dataInLen; i++)
    gUDS_TxBuf[3 + i] = dataIn[i];
  gUDS_TxLen = 3 + dataInLen;
  if (UDS_SendRaw() <= 0) { UDS_FormatRxSummary(3); return 0; }
  UDS_FormatRxSummary(3);
  return UDS_IsPositiveResponse(0x2E);
}

/******************************************************************************
 * 31 01 xx xx 启动例程 (无额外载荷)
 ******************************************************************************/
int UDS_RoutineControl_Start(word routineId, byte dataOut[], long &dataOutLen)
{
  long i;
  gUDS_TxBuf[0] = 0x31; gUDS_TxBuf[1] = 0x01;
  gUDS_TxBuf[2] = (byte)((routineId >> 8) & 0xFF);
  gUDS_TxBuf[3] = (byte)(routineId & 0xFF);
  gUDS_TxLen = 4;
  if (UDS_SendRaw() <= 0) { UDS_FormatRxSummary(3); return 0; }
  if (!UDS_IsPositiveResponse(0x31)) { UDS_FormatRxSummary(3); return 0; }
  UDS_FormatRxSummary((gUDS_RxLen <= 5) ? (int)gUDS_RxLen : 5);
  dataOutLen = (gUDS_RxLen > 4) ? (long)(gUDS_RxLen - 4) : 0;
  for (i = 0; i < dataOutLen; i++)
    dataOut[i] = gUDS_RxBuf[4 + i];
  return 1;
}

/******************************************************************************
 * 31 01 xx xx [payload] 启动例程 (带载荷，用于证书写入)
 ******************************************************************************/
int UDS_RoutineControl_StartWithData(word routineId,
                                     byte payloadIn[], long payloadInLen,
                                     byte dataOut[],   long &dataOutLen)
{
  long i;
  gUDS_TxBuf[0] = 0x31; gUDS_TxBuf[1] = 0x01;
  gUDS_TxBuf[2] = (byte)((routineId >> 8) & 0xFF);
  gUDS_TxBuf[3] = (byte)(routineId & 0xFF);
  if (payloadInLen > 4092)
  {
    write("UDS_Services: RoutineControl载荷过大 %d>4092", payloadInLen);
    return 0;
  }
  for (i = 0; i < payloadInLen; i++)
    gUDS_TxBuf[4 + i] = payloadIn[i];
  gUDS_TxLen = (int)(4 + payloadInLen);
  if (UDS_SendRaw() <= 0) { UDS_FormatRxSummary(3); return 0; }
  if (!UDS_IsPositiveResponse(0x31)) { UDS_FormatRxSummary(3); return 0; }
  UDS_FormatRxSummary((gUDS_RxLen <= 5) ? (int)gUDS_RxLen : 5);
  dataOutLen = (gUDS_RxLen > 4) ? (long)(gUDS_RxLen - 4) : 0;
  for (i = 0; i < dataOutLen; i++)
    dataOut[i] = gUDS_RxBuf[4 + i];
  return 1;
}

/******************************************************************************
 * 34 请求下载
 *   dataFmtId:    DataFormatIdentifier (通常0x00=无压缩无加密)
 *   addrLenFmtId: AddressAndLengthFormatIdentifier (如0x44=4字节地址+4字节长度)
 *   addr:         内存起始地址
 *   size:         下载数据大小
 *   maxBlockLen:  [输出] ECU返回的MaxNumberOfBlockLength
 ******************************************************************************/
int UDS_RequestDownload(byte dataFmtId, byte addrLenFmtId,
                        dword addr, dword size, dword &maxBlockLen)
{
  int addrBytes, sizeBytes, idx, i;

  addrBytes = addrLenFmtId & 0x0F;
  sizeBytes = (addrLenFmtId >> 4) & 0x0F;

  gUDS_TxBuf[0] = 0x34;
  gUDS_TxBuf[1] = dataFmtId;
  gUDS_TxBuf[2] = addrLenFmtId;
  idx = 3;
  /* 地址 (大端) */
  for (i = addrBytes - 1; i >= 0; i--)
    gUDS_TxBuf[idx++] = (byte)((addr >> (i * 8)) & 0xFF);
  /* 长度 (大端) */
  for (i = sizeBytes - 1; i >= 0; i--)
    gUDS_TxBuf[idx++] = (byte)((size >> (i * 8)) & 0xFF);
  gUDS_TxLen = idx;

  if (UDS_SendRaw() <= 0) { UDS_FormatRxSummary(3); return 0; }
  if (!UDS_IsPositiveResponse(0x34)) { UDS_FormatRxSummary(3); return 0; }
  UDS_FormatRxSummary((int)gUDS_RxLen);

  /* 解析 MaxNumberOfBlockLength: 响应 74 LengthFormatId [maxBlockLen nB] */
  maxBlockLen = 0;
  if (gUDS_RxLen >= 2)
  {
    int mblBytes;
    mblBytes = (gUDS_RxBuf[1] >> 4) & 0x0F;
    for (i = 0; i < mblBytes && (2 + i) < (int)gUDS_RxLen; i++)
      maxBlockLen = (maxBlockLen << 8) | (dword)gUDS_RxBuf[2 + i];
  }
  return 1;
}

/******************************************************************************
 * 36 传输数据
 *   blockSeq: BlockSequenceCounter (从0x01开始, 0xFF后回绕到0x00)
 *   data[]:   本块数据
 *   dataLen:  数据长度
 ******************************************************************************/
int UDS_TransferData(byte blockSeq, byte data[], int dataLen)
{
  int i;
  if (dataLen > 4094)
  {
    write("UDS_Services: TransferData数据过大 %d>4094", dataLen);
    return 0;
  }
  gUDS_TxBuf[0] = 0x36;
  gUDS_TxBuf[1] = blockSeq;
  for (i = 0; i < dataLen; i++)
    gUDS_TxBuf[2 + i] = data[i];
  gUDS_TxLen = 2 + dataLen;
  if (UDS_SendRaw() <= 0) { UDS_FormatRxSummary(2); return 0; }
  UDS_FormatRxSummary(2);
  return UDS_IsPositiveResponse(0x36);
}

/******************************************************************************
 * 37 请求传输退出
 ******************************************************************************/
int UDS_RequestTransferExit()
{
  gUDS_TxBuf[0] = 0x37;
  gUDS_TxLen = 1;
  if (UDS_SendRaw() <= 0) { UDS_FormatRxSummary(1); return 0; }
  UDS_FormatRxSummary(1);
  return UDS_IsPositiveResponse(0x37);
}

/******************************************************************************
 * CRC32 计算 (多项式0xEDB88320, 初始0xFFFFFFFF)
 ******************************************************************************/
dword UDS_CalcCRC32(byte data[], long dataLen)
{
  dword crc;
  long  i;
  int   j;
  crc = cCRC32_INIT;
  for (i = 0; i < dataLen; i++)
  {
    crc ^= (dword)data[i];
    for (j = 0; j < 8; j++)
      crc = (crc & 1) ? ((crc >> 1) ^ cCRC32_POLY) : (crc >> 1);
  }
  return crc;
}

/******************************************************************************
 * 工具: 字节数组转十六进制字符串(日志用)
 ******************************************************************************/
void UDS_FormatHex(byte data[], long len, char outStr[], long outSize)
{
  long i, pos;
  char tmp[4];
  pos = 0; outStr[0] = 0;
  for (i = 0; i < len && pos < outSize - 4; i++)
  {
    if (i > 0) { outStr[pos] = ' '; pos++; }
    snprintf(tmp, elcount(tmp), "%02X", data[i]);
    outStr[pos] = tmp[0]; outStr[pos+1] = tmp[1]; pos += 2;
  }
  outStr[pos] = 0;
}

/******************************************************************************
 * 工具: 格式化DUT响应摘要到 gUDS_RxSummary
 ******************************************************************************/
void UDS_FormatRxSummary(int n)
{
  int i, pos;
  char tmp[8];
  if (n > (int)gUDS_RxLen) n = (int)gUDS_RxLen;
  pos = 0; gUDS_RxSummary[0] = 0;
  for (i = 0; i < n && pos < elcount(gUDS_RxSummary) - 8; i++)
  {
    if (i > 0) { gUDS_RxSummary[pos] = ','; pos++; }
    snprintf(tmp, elcount(tmp), "0x%02X", gUDS_RxBuf[i]);
    gUDS_RxSummary[pos]   = tmp[0];
    gUDS_RxSummary[pos+1] = tmp[1];
    gUDS_RxSummary[pos+2] = tmp[2];
    gUDS_RxSummary[pos+3] = tmp[3];
    pos += 4;
  }
  gUDS_RxSummary[pos] = 0;
}
